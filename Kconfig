## Kconfig
```kconfig
rsource "drivers/Kconfig"
rsource "behaviors/Kconfig"
rsource "input_processors/Kconfig"

config INPUT_IQS9151_STUDIO_RPC
    bool "Enable IQS9151 custom Studio RPC"
    depends on ZMK_STUDIO_RPC
    select ZMK_SPLIT_RELAY_EVENT if ZMK_SPLIT
    help
      Enable the IQS9151 custom Studio RPC subsystem using ZMK custom
      Studio RPC. The subsystem identifiers are dya__iqs9151 and
      zmk__iqs9151. If the IQS9151 device is on a split peripheral,
      requests are relayed to that peripheral when ZMK split relay
      events are enabled.
```

## behaviors/Kconfig
```kconfig
menuconfig ZMK_BEHAVIOR_TRACKPAD_TO_POS
    bool "Trackpad to position behavior"
    default y
    depends on DT_HAS_ZMK_BEHAVIOR_TRACKPAD_TO_POS_ENABLED
    help
      Enable the trackpad-to-position behavior that raises position_state_changed
      events for a virtual key position.

menuconfig ZMK_BEHAVIOR_ZIP_DYNAMIC_SCALE
    bool "Dynamic scale adjust behavior"
    default y
    depends on DT_HAS_ZMK_BEHAVIOR_ZIP_DYNAMIC_SCALE_ENABLED
    help
      Enable the behavior that adjusts the dynamic scale factor used by
      the dynamic scaler input processor.

menuconfig ZMK_BEHAVIOR_ZIP_DYNAMIC_SCALE_SET
    bool "Dynamic scale set behavior"
    default y
    depends on DT_HAS_ZMK_BEHAVIOR_ZIP_DYNAMIC_SCALE_SET_ENABLED
    help
      Enable the behavior that sets the dynamic scale factor used by
      the dynamic scaler input processor.
```
